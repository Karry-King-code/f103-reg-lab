#include "stm32f10x.h"
/* OLED 双方向 I2C 扫描（纯寄存器临时固件，ch08 诊断用）
   PB8=CRH[3:0] PB9=CRH[7:4]；输出推挽2M=0x2；输入=0x8(CNF=10,高/低由ODR定) */
static void dly(void){ volatile uint32_t n=800; while(n--){} }
static uint8_t g_sw = 0;   /* 0=SCL=PB8/SDA=PB9；1=对调 */
static void uart1_send(uint8_t b){ while((USART1->SR&USART_SR_TXE)==0){} USART1->DR=b; }
static void uart1_str(const char*s){ while(*s) uart1_send((uint8_t)*s++); }
#define SCL_BIT  (g_sw ? (1u<<9) : (1u<<8))
#define SDA_BIT  (g_sw ? (1u<<8) : (1u<<9))
static void cfg_scl_out(void){
  if(!g_sw){ GPIOB->CRH=(GPIOB->CRH&0xFFFFFFF0U)|0x00000002U; }
  else     { GPIOB->CRH=(GPIOB->CRH&0xFFFFFF0FU)|0x00000020U; }
  GPIOB->ODR|=SCL_BIT;
}
static void cfg_sda_out_lo(void){
  if(!g_sw){ GPIOB->CRH=(GPIOB->CRH&0xFFFFFF0FU)|0x00000020U; }
  else     { GPIOB->CRH=(GPIOB->CRH&0xFFFFFFF0U)|0x00000002U; }
  GPIOB->ODR&=~SDA_BIT;
}
static void cfg_sda_in(void){
  if(!g_sw){ GPIOB->CRH=(GPIOB->CRH&0xFFFFFF0FU)|0x00000080U; }
  else     { GPIOB->CRH=(GPIOB->CRH&0xFFFFFFF0U)|0x00000080U; }
  GPIOB->ODR|=SDA_BIT;
}
static uint8_t sda_rd(void){ return (uint8_t)((GPIOB->IDR & SDA_BIT)?1:0); }
static void scl_hi(void){ GPIOB->ODR|=SCL_BIT; }
static void scl_lo(void){ GPIOB->ODR&=~SCL_BIT; }
static uint8_t wr(uint8_t b){ uint8_t i,ack;
  for(i=0;i<8;i++){ if(b&0x80) cfg_sda_in(); else cfg_sda_out_lo(); b<<=1; dly(); scl_hi(); dly(); scl_lo(); }
  cfg_sda_in(); dly(); scl_hi(); dly(); ack=sda_rd(); scl_lo(); return ack; }
static void start(void){ cfg_sda_in(); dly(); scl_hi(); dly(); cfg_sda_out_lo(); dly(); scl_lo(); dly(); }
static void stop(void){ cfg_sda_out_lo(); dly(); scl_hi(); dly(); cfg_sda_in(); dly(); }
void delay_ms(uint32_t ms){ uint32_t t=SystemCoreClock/8/1000; SysTick->LOAD=t-1; SysTick->VAL=0;
  SysTick->CTRL=SysTick_CTRL_ENABLE_Msk; while(ms--) while((SysTick->CTRL&SysTick_CTRL_COUNTFLAG_Msk)==0){} SysTick->CTRL=0; }

/* 5x7 font ASCII 0x20..0x5F */
static const uint8_t F57[] = {
0x00,0x00,0x00,0x00,0x00, 0x00,0x00,0x5F,0x00,0x00, 0x00,0x07,0x00,0x07,0x00, 0x14,0x7F,0x14,0x7F,0x14,
0x24,0x2A,0x7F,0x2A,0x12, 0x23,0x13,0x08,0x64,0x62, 0x36,0x49,0x55,0x22,0x50, 0x00,0x05,0x03,0x00,0x00,
0x00,0x1C,0x22,0x41,0x00, 0x00,0x41,0x22,0x1C,0x00, 0x14,0x08,0x3E,0x08,0x14, 0x08,0x08,0x3E,0x08,0x08,
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0x63,0x14,0x08,0x14,0x63, 0x07,0x08,0x70,0x08,0x07, 0x61,0x51,0x49,0x45,0x43 };
static void o_cmd(uint8_t c){ start(); wr(0x78); wr(0x00); wr(c); stop(); }
static void o_data(uint8_t d){ start(); wr(0x78); wr(0x40); wr(d); stop(); }
static void o_pos(uint8_t pg, uint8_t col){ o_cmd(0xB0|pg); o_cmd(0x00|(col&0x0F)); o_cmd(0x10|(col>>4)); }
static void o_print(uint8_t pg, uint8_t col, const char *s){
  o_pos(pg,col);
  while(*s){ uint8_t c=(uint8_t)*s++; uint8_t i;
    if(c<0x20||c>0x5F) c=' ';
    for(i=0;i<5;i++) o_data(F57[(c-0x20)*5+i]);
    o_data(0x00); }
}
static void o_clear(uint8_t pg){ uint8_t i; o_pos(pg,0); for(i=0;i<128;i++) o_data(0x00); }
static void o_init(void){
  uint8_t i; for(i=0;i<100;i++) dly();
  start(); wr(0x78); wr(0x00);
  wr(0xAE); wr(0xD5); wr(0x80); wr(0xA8); wr(0x3F); wr(0xD3); wr(0x00);
  wr(0x40); wr(0x8D); wr(0x14); wr(0x20); wr(0x02); wr(0xA1); wr(0xC8);
  wr(0xDA); wr(0x12); wr(0x81); wr(0xCF); wr(0xD9); wr(0xF1); wr(0xDB);
  wr(0x40); wr(0xA4); wr(0xA6); wr(0xAF);
  stop();
}

int main(void){
    SystemCoreClockUpdate();
  RCC->APB2ENR |= RCC_APB2ENR_IOPAEN|RCC_APB2ENR_IOPBEN|RCC_APB2ENR_IOPCEN|RCC_APB2ENR_USART1EN;
  GPIOA->CRH = (GPIOA->CRH & 0xFFFF00FFU) | 0x000004B0U;
  USART1->BRR = 0x271; USART1->CR1 |= USART_CR1_UE; USART1->CR1 |= USART_CR1_TE|USART_CR1_RE;
  GPIOC->CRH = (GPIOC->CRH & 0xFF0FFFFFU) | 0x00200000U;
  GPIOB->CRH = (GPIOB->CRH & 0xFFFFFF00U) | 0x00000088U;
  GPIOB->ODR &= ~((1u<<8)|(1u<<9));
  delay_ms(2);
  uart1_str("IPD8="); uart1_send((uint8_t)('0'+((GPIOB->IDR>>8)&1)));
  uart1_str(" IPD9="); uart1_send((uint8_t)('0'+((GPIOB->IDR>>9)&1)));
  GPIOB->ODR |= (1u<<8)|(1u<<9);
  delay_ms(2);
  uart1_str(" IPU8="); uart1_send((uint8_t)('0'+((GPIOB->IDR>>8)&1)));
  uart1_str(" IPU9="); uart1_send((uint8_t)('0'+((GPIOB->IDR>>9)&1)));
  uart1_str("\r\n");
  g_sw=0; cfg_scl_out(); cfg_sda_in();
  o_init();
  { uint8_t p2; for(p2=0;p2<8;p2++) o_clear(p2); }
  o_print(0, 0, "F103 SMART ENV");
  o_print(2, 0, "LIGHT:");
  o_print(2, 48, "OK");
  o_print(4, 0, "HUMI:--");
  o_print(6, 0, "TEMP:--");
  { uint8_t lastv = (uint8_t)((GPIOB->IDR>>12)&1);
    o_print(2, 48, lastv ? "OK " : "DARK");
    while(1){
      uint8_t now = (uint8_t)((GPIOB->IDR>>12)&1);   /* 光敏 DO = PB12 */
      if(now != lastv){
        lastv = now;
        o_print(2, 48, now ? "OK " : "DARK");
      }
      delay_ms(30);
      GPIOC->ODR ^= GPIO_ODR_ODR13;
    }
  }
}
